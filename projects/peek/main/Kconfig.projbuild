## projects/peek/main/Kconfig.projbuild
```kconfig
menu "Peek diagnostics"
config PEEK_DIAGNOSTIC_VIEW
    bool "Start firmware in thermal diagnostic view"
    default n
    help
        Keep the production detector and acquisition unchanged, but show the
        thermal diagnostic screen instead of the approved single dragon eye.
        Host preview selects its view separately with --view diagnostic.
config PEEK_CHARACTER
    int "Startup character (0=dragon,2=deep sea,3=mechanical)"
    range 0 3
    default 0
    help
        ID1 is retired and rejected by the build; existing IDs are retained.
        All characters use the same source-owned detector and behavior. New
        bitmap eyes retain full480 detail; sample step applies to dragon only.
config PEEK_EYE_SAMPLE_STEP
    int "Dragon eye sample step (1=480,2=240 samples with480 output)"
    range 1 2
    default 2
    help
        Step2 is the user-approved2x2 sampling/replication mode. It affects
        eye pixels only. Complete thermal frames and detection stay unchanged.
config PEEK_GAZE_FLIP_X
    bool "Flip horizontal target-to-gaze mapping for the physical mount"
    default n
config PEEK_GAZE_FLIP_Y
    bool "Flip vertical target-to-gaze mapping for the physical mount"
    default n
config PEEK_AUTO_ORIENTATION
    bool "Keep eye upright using BMI270 after device settles"
    default y
    help
        Four directions only. Motion, ambiguous diagonal/flat placement and
        read failures hold the last direction. Raw thermal data stays native.
config PEEK_FIXED_ORIENTATION
    int "Fixed/startup eye direction (0=0,1=90,2=180,3=270 clockwise)"
    range 0 3
    default 0
    help
        With automatic orientation off this is the fixed display direction.
        With it on this is retained until a reliable placement is available.
config PEEK_IMU_MOUNT_QUARTERS
    int "IMU-to-screen clockwise mounting quarter-turns"
    depends on PEEK_AUTO_ORIENTATION
    range 0 3
    default 0
    help
        Additional clockwise mounting after the measured sensor-to-screen
        axis conversion (-accel_x,+accel_y). Default0 matches the labelled
        upright and clockwise90 poses on30:ed:a0:f4:52:a0.
        Does not alter thermal mounting calibration.
endmenu
```
